## config/west.yml
```yaml
manifest:
  remotes:
    - name: zmkfirmware
      url-base: https://github.com/zmkfirmware
    - name: duckyb
      url-base: https://github.com/duckyb
  projects:
    - name: zmk
      remote: zmkfirmware
      revision: main
      import: app/west.yml
  self:
    path: config
```

## west.yml
```yaml
manifest:
  remotes:
    - name: zmkfirmware
      url-base: https://github.com/zmkfirmware
    - name: duckyb
      url-base: https://github.com/duckyb
  projects:
    - name: zmk
      remote: zmkfirmware
      revision: main
      import: true
    - name: zmk-urchin
      remote: duckyb
      revision: main
  self:
    path: config
```
